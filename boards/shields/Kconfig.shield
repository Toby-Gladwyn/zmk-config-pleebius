## boards/shields/Kconfig.shield
```kconfig
config SHIELD_PLEEBIUS_LEFT
    def_bool $(shields_list_contains,pleebius_left)

config SHIELD_PLEEBIUS_RIGHT
    def_bool $(shields_list_contains,pleebius_right)
```

## boards/shields/pleebius/Kconfig.defconfig
```kconfig
if SHIELD_PLEEBIUS_LEFT

config ZMK_KEYBOARD_NAME
    default "pleebius"

config ZMK_SPLIT_ROLE_CENTRAL
    default y

endif

if SHIELD_PLEEBIUS_LEFT || SHIELD_PLEEBIUS_RIGHT

config ZMK_SPLIT
    default y

endif
```
